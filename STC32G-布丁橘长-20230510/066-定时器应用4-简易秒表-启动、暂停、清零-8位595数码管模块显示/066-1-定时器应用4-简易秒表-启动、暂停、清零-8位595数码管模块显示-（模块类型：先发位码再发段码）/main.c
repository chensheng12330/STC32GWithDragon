//		@布丁橘长 2023/02/16
//		简易秒表程序，启动/暂停，清零功能
//		使用定时器0-模式0-1T模式-预分频-定时10毫秒
//		8位共阳极数码管模块-74HC595级联驱动：第1、2位显示分钟，第4、5位显示秒钟，第7、8位显示毫秒
//		数码管模块引脚定义：DS(DIO):P6.6 SH(SCK):P6.5 ST(RCK):P6.4（先发位码，再发段码）
//		开发板板载按键：KEY1-P3.3：启动/暂停，KEY2-P3.2：清零（只在暂停时清零）
//		实验开发板：STC32G12K128-LQFP64 屠龙刀三.1 ，程序主频12MHz

#include <STC32G.H>
#include "config.h"				//配置头文件，包含主频定义，数据类型定义
#include "seg595.h"				//8位595数码管模块（先发位码，再发段码）

#define START 1						//秒表状态：启动1，暂停2，清零3
#define STOP  2
#define CLEAR 3

sbit KEY1 = P3^3;					
sbit KEY2 = P3^2;

void Timer0_Init(void);		//定时器0初始化函数声明
void clock();							//秒表函数声明
void keyscan();						//按键扫描函数声明

u8 min,sec,msec;									//全局变量：分钟、秒钟、毫秒
u8 timing;												//秒表状态变量
u8 key1press,key2press,key1nums;	//按键1、2按下标志，按键1按键次数

void main()
{	
	EAXFR = 1; 			// 使能访问 XFR
	CKCON = 0x00; 	// 设置外部数据总线速度为最快
	WTST = 0x00;		// 设置程序代码等待参数，等待时间为0个时钟，CPU执行程序速度最快

	P0M1 = 0x00;P0M0 = 0x00;		//设置P0口为准双向口模式 //00：准双向口 01：推挽输出 10：高阻输入 11：开漏输出
	P1M1 = 0x00;P1M0 = 0x00;		//设置P1口为准双向口模式 //00：准双向口 01：推挽输出 10：高阻输入 11：开漏输出
	P2M1 = 0x00;P2M0 = 0x00;		//设置P2口为准双向口模式 //00：准双向口 01：推挽输出 10：高阻输入 11：开漏输出
	P3M1 = 0x00;P3M0 = 0x00;		//设置P3口为准双向口模式 //00：准双向口 01：推挽输出 10：高阻输入 11：开漏输出
	P4M1 = 0x00;P4M0 = 0x00;		//设置P4口为准双向口模式 //00：准双向口 01：推挽输出 10：高阻输入 11：开漏输出
	P5M1 = 0x00;P5M0 = 0x00;		//设置P5口为准双向口模式 //00：准双向口 01：推挽输出 10：高阻输入 11：开漏输出
	P6M1 = 0x00;P6M0 = 0x00;		//设置P6口为准双向口模式 //00：准双向口 01：推挽输出 10：高阻输入 11：开漏输出
	P7M1 = 0x00;P7M0 = 0x00;		//设置P7口为准双向口模式 //00：准双向口 01：推挽输出 10：高阻输入 11：开漏输出
	
	Timer0_Init();		//定时器0初始化
	EA = 1;						//使能总中断	
	while(1)
	{
		SEG_Disp((u8)(min/10),1);			//分钟-十位，数码管左边第1位
		SEG_Disp((u8)(min%10),2);			//分钟-个位，数码管左边第2位
		SEG_Disp(23,3);								//分隔-横杆，数码管左边第3位
		SEG_Disp((u8)(sec/10),4);			//秒钟-十位，数码管左边第4位
		SEG_Disp((u8)(sec%10),5);			//秒钟-个位，数码管左边第5位
		SEG_Disp(23,6);								//分隔-横杆，数码管左边第6位
		SEG_Disp((u8)(msec/10),7);		//毫秒-百位，数码管左边第7位
		SEG_Disp((u8)(msec%10),8);		//毫秒-十位，数码管左边第8位
	}
}
void Timer0_Isr(void) interrupt 1
{
	clock();												//秒表函数
	keyscan();											//按键扫描函数
	if(timing == START) msec++;			//秒表启动状态
	else if(timing == CLEAR) 				//如果清零标志位1，清零分钟、秒钟、毫秒、按键次数
	{
		min = 0;		
		sec = 0;
		msec = 0;
		key1nums = 0;
	}
	if(key1press > 0) key1press++;		//按键1，延时消抖，每次中断+1,延时时间在10-20毫秒之间
	if(key2press > 0) key2press++;		//按键2，延时消抖，每次中断+1,延时时间在10-20毫秒之间
}

void Timer0_Init(void)		//10毫秒@12.000MHz
{
	TM0PS = 0x01;						//设置定时器时钟预分频 ( 注意:并非所有系列都有此寄存器,详情请查看数据手册 )
	AUXR |= 0x80;						//定时器时钟1T模式
	TMOD &= 0xF0;						//设置定时器模式
	TL0 = 0xA0;							//设置定时初始值
	TH0 = 0x15;							//设置定时初始值
	TF0 = 0;								//清除TF0标志
	TR0 = 1;								//定时器0开始计时
	ET0 = 1;								//使能定时器0中断
}
void clock()											//秒表函数
{
	if(msec > 99)										//1000毫秒即1秒
	{
		msec = 0;											//清零毫秒数
		if(sec++ >= 59)								//60秒即1分
		{
			sec = 0;										//清零秒数
			if(min++ >= 99) 						//计时最大99分59秒990毫秒，超出就清零
			{
				min = 0;	
				sec = 0;
				msec = 0; 
			}
		}
	}
}
void keyscan()
{
//------------------KEY1-------------------------//按键1：启动/暂停
	if(KEY1 == 0 && key1press == 0)	key1press = 1; //按键1按下， 开始延时消抖
	if(KEY1 == 0 && key1press == 3)									//10-20毫秒延时，key1press由定时器中断自增，时间在10-20毫秒之间
	{
		key1nums++;																		//按键1次数
		if(key1nums > 99) key1nums = 0;								//防溢出，大于99清零按键次数
		if((key1nums & 0x01) == 0x01)	timing = START;	//奇数次按键，启动秒表
		if((key1nums & 0x01) == 0x00)	timing = STOP;	//偶数次按键，暂停秒表
	}
	if(KEY1 == 1) key1press = 0;										//按键1松开后，清零key1press

//------------------KEY2-------------------------	//按键2：清零
	if(KEY2 == 0 && key2press == 0)	key2press = 1;	//按键2按下， 开始延时消抖
	if(KEY2 == 0 && key2press == 3)									//10-20毫秒延时，key1press由定时器中断自增，时间在10-20毫秒之间
	{
		if(timing == STOP)	timing = CLEAR;						//只有秒表暂停状态，才能清零
	}
	if(KEY2 == 1) key2press = 0;										//按键2松开后，清零key2press
}