//		@布丁橘长 2023/02/14
//		使用定时器0-模式0-1T模式-预分频直接定时1秒
//		8位共阳极数码管模块-74HC595级联驱动：第1、2位显示0-99计时，第7、8位显示99-0倒计时
//		数码管模块引脚定义：DS(DIO):P6.6 SH(SCK):P6.5 ST(RCK):P6.4
//		实验开发板：STC32G12K128-LQFP64 屠龙刀三.1 主频12MHz

#include <STC32G.H>
#include "config.h"
#include "seg595.h"

void Timer0_Init(void);		//定时器0初始化函数声明
void Timer1_Init(void);		//定时器1初始化函数声明

u16 number;				//数码管显示的数字
u16 freq;
u8 keypress;
void main()
{	
	EAXFR = 1; 			// 使能访问 XFR
	CKCON = 0x00; 	// 设置外部数据总线速度为最快
	WTST = 0x00;		// 设置程序代码等待参数，等待时间为0个时钟，CPU执行程序速度最快

	P0M1 = 0x00;P0M0 = 0x00;		//设置P0口为准双向口模式 //00：准双向口 01：推挽输出 10：高阻输入 11：开漏输出
	P1M1 = 0x00;P1M0 = 0x00;		//设置P1口为准双向口模式 //00：准双向口 01：推挽输出 10：高阻输入 11：开漏输出
	P2M1 = 0x00;P2M0 = 0x00;		//设置P2口为准双向口模式 //00：准双向口 01：推挽输出 10：高阻输入 11：开漏输出
	P3M1 = 0x00;P3M0 = 0x00;		//设置P3口为准双向口模式 //00：准双向口 01：推挽输出 10：高阻输入 11：开漏输出
	P4M1 = 0x00;P4M0 = 0x00;		//设置P4口为准双向口模式 //00：准双向口 01：推挽输出 10：高阻输入 11：开漏输出
	P5M1 = 0x00;P5M0 = 0x00;		//设置P5口为准双向口模式 //00：准双向口 01：推挽输出 10：高阻输入 11：开漏输出
	P6M1 = 0x00;P6M0 = 0x00;		//设置P6口为准双向口模式 //00：准双向口 01：推挽输出 10：高阻输入 11：开漏输出
	P7M1 = 0x00;P7M0 = 0x00;		//设置P7口为准双向口模式 //00：准双向口 01：推挽输出 10：高阻输入 11：开漏输出
	
	Timer0_Init();		//定时器0初始化
	Timer1_Init();		//定时器0初始化
	EA = 1;						//使能总中断	
	while(1)
	{
		if(P32 == 0 && keypress == 0) //按P3.2开始测量
		{
			keypress = 1;
			number = 0;
			TR1 = 1;
			TR0 = 1;
		}
		if(P32 == 1) keypress = 0;
		freq = number*10;
		SEG_Disp(15,1);		//F
		SEG_Disp(23,2);		//-	
		SEG_Disp((u16)(freq/10000%10),4);				//频率万位
		SEG_Disp((u16)(freq/1000%10),5);				//千位
		SEG_Disp((u16)(freq/100%10),6);					//百位
		SEG_Disp((u16)(freq/10%10),7);					//十位
		SEG_Disp((u16)(freq%10),8);							//个位
	}
}
void Timer0_Isr(void) interrupt 1		
{
	number++;
}

void Timer0_Init(void)		
{
	TMOD = 0x04;						//定时器0-模式1-16位不自动重装模式-计数模式
	TL0 = 0xFF;							//设置定时初始值
	TH0 = 0xFF;							//设置定时初始值
	TF0 = 0;								//清除TF0标志
	ET0 = 1;								//使能定时器0中断
}
void Timer1_Isr(void) interrupt 3
{
	TR0 = 0;
	TR1 = 0;
}
void Timer1_Init(void)		//100毫秒@12.000MHz
{
	TM1PS = 0x12;			//设置定时器时钟预分频 ( 注意:并非所有系列都有此寄存器,详情请查看数据手册 )
	AUXR |= 0x40;			//定时器时钟1T模式
	TMOD &= 0x0F;			//设置定时器模式
	TL1 = 0x4A;				//设置定时初始值
	TH1 = 0x09;				//设置定时初始值
	TF1 = 0;				//清除TF1标志
	TR1 = 1;				//定时器1开始计时
	ET1 = 1;				//使能定时器1中断
}