//	@布丁橘长 2023/04/01
// 	不停电下载示例：MCU端按键(P3.2)触发进入ISP下载模式，PC端点击下载
//  长按P3.2按键0.5秒，即可进入ISP下载模式，PC端再点击下载（第一次下载需要按P3.2和OFF，并用STC-ISP下载）
//	实验开发板：STC32G12K128屠龙刀三.1 主频@12MHz

#include <STC32G.H>
#include "config.h"

void sysini(void);						// STC32初始化设置
void Timer0_Init(void);				// 定时器0初始化	
void Blink(void);							// LED闪烁函数，此处为P2口流水灯效果
void KeyResetScan(void);			// 下载按钮监测函数
void delay_ms(u8 ms);					// ms*1毫秒延时函数

//P3.2口按键复位所需变量
bit Key_Flag;
u16 Key_cnt;
//-----------------------

bit B_1ms;										// 1ms标志
u16 blinkdelay;								// LED闪烁延时计数

void main(void)
{
	sysini();										// STC32初始化设置
	Timer0_Init();							// 定时器0初始化
	EA = 1;											// 使能EA总中断
	
	while(1)
	{
		Blink();									// LED闪烁函数，此处为P2口流水灯效果
	}
}
void sysini()
{
	EAXFR = 1; 									// 使能访问 XFR
	CKCON = 0x00; 							// 设置外部数据总线速度为最快
	WTST = 0x00;								// 设置程序代码等待参数，等待时间为0个时钟，CPU执行程序速度最快

	P0M1 = 0xFF;P0M0 = 0x00;		// 设置P0口为准双向口模式 //00：准双向口 01：推挽输出 10：高阻输入 11：开漏输出
	P1M1 = 0x00;P1M0 = 0x00;		// 设置P1口为准双向口模式 //00：准双向口 01：推挽输出 10：高阻输入 11：开漏输出
	P2M1 = 0x00;P2M0 = 0x00;		// 设置P2口为准双向口模式 //00：准双向口 01：推挽输出 10：高阻输入 11：开漏输出
	P3M1 = 0x00;P3M0 = 0x00;		// 设置P3口为准双向口模式 //00：准双向口 01：推挽输出 10：高阻输入 11：开漏输出
	P4M1 = 0x00;P4M0 = 0x00;		// 设置P4口为准双向口模式 //00：准双向口 01：推挽输出 10：高阻输入 11：开漏输出
	P5M1 = 0x00;P5M0 = 0x00;		// 设置P5口为准双向口模式 //00：准双向口 01：推挽输出 10：高阻输入 11：开漏输出
	P6M1 = 0x00;P6M0 = 0x00;		// 设置P6口为准双向口模式 //00：准双向口 01：推挽输出 10：高阻输入 11：开漏输出
	P7M1 = 0x00;P7M0 = 0x00;		// 设置P7口为准双向口模式 //00：准双向口 01：推挽输出 10：高阻输入 11：开漏输出
}
void Blink(void)							// LED闪烁函数，此处为P2口流水灯效果
{
	static u8 i;								
	if(B_1ms == 1)							// 1毫秒到
	{
		B_1ms = 0;								// 清零1毫秒标志
		blinkdelay++;							// 闪烁延时标志置1
	}
	if(blinkdelay == 500)				// 500毫秒到
	{
		P2 = ~(0x01 << i);				// 0x01左移i位，即P2口8个LED轮流点亮
		i++;											
		if(i > 7) i = 0;					// i在0-7范围自增
		blinkdelay = 0;						// 清零闪烁延时标志
	}
}
void Timer0_Isr(void) interrupt 1
{
	B_1ms = 1;									// 提供1毫秒节拍，可用于延时计数
	KeyResetScan();							// 下载按钮监测
}
void Timer0_Init(void)				//1毫秒@12.000MHz
{
	AUXR |= 0x80;								//定时器时钟1T模式
	TMOD &= 0xF0;								//设置定时器模式
	TL0 = 0x20;									//设置定时初始值
	TH0 = 0xD1;									//设置定时初始值
	TF0 = 0;										//清除TF0标志
	TR0 = 1;										//定时器0开始计时
	ET0 = 1;										//使能定时器0中断
}
//========================================================================
// 函数: void KeyResetScan(void)
// 描述: P3.2口按键长按0.5秒触发软件复位，进入USB下载模式。
// 参数: none.
// 返回: none.
// 版本: VER1.0
// 日期: 2022-6-11
// 备注: 
//========================================================================
void KeyResetScan(void)
{
    if(!P32)
    {
        if(!Key_Flag)
        {
            Key_cnt++;
            if(Key_cnt >= 500)			//连续500ms有效按键检测
            {
                Key_Flag = 1;				//设置按键状态，防止重复触发

                USBCON = 0x00;      //清除USB设置
                USBCLK = 0x00;
                IRC48MCR = 0x00;
                
								delay_ms(10);
                IAP_CONTR = 0x60;   //触发软件复位，从ISP开始执行
                while (1);
            }
        }
    }
    else
    {
        Key_cnt = 0;
        Key_Flag = 0;
    }
}
//========================================================================
// 函数: void delay_ms(u8 ms)
// 描述: 延时函数。
// 参数: ms,要延时的ms数, 这里只支持1~255ms. 自动适应主时钟.
// 返回: none.
// 版本: VER1.0
// 日期: 2022-6-3
// 备注: 
//========================================================================
void delay_ms(u8 ms)
{
    u16 i;
    do{
        i = MAIN_Fosc / 6000;
        while(--i);   //6T per loop
    }while(--ms);
}