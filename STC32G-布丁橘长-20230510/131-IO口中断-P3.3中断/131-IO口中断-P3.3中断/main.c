//	@布丁橘长 2023/04/07
//  IO口中断示例：P3.3口中断示例
// 	实验效果：单片机运行P2.7 LED常亮，IO口中断后P2.7 LED闪烁3次
//  不同IO口中断，需要在isr.asm中修改中断向量地址
//	实验开发板：STC32G12K128屠龙刀三.1 主频@12MHz

#include <STC32G.H>
#include "config.h"
#include "delay.h"

void sysini(void);						// STC32初始化设置
void Blink();									// LED闪烁函数

void main(void)
{
	sysini();										// STC32初始化设置
	
	P3IM1 = 0x00;P3IM0 = 0x00;	// P3.3设置为下降沿触发
// 	P3IM1 = 0x00;P3IM0 = 0x08;	// P3.3设置为上升沿触发
//	P3IM1 = 0x08;P3IM0 = 0x00;	// P3.3设置为低电平触发
//	P3IM1 = 0x08;P3IM0 = 0x08;	// P3.3设置为高电平触发
	
	P3INTE = 0x08;							// 使能P3.3口中断

	EA = 1;											// 使能EA总中断
	
	while(1)
	{
		P27 = 0;									// P2.7 LED常亮
	}
}
void sysini()
{
	EAXFR = 1; 									// 使能访问 XFR
	CKCON = 0x00; 							// 设置外部数据总线速度为最快
	WTST = 0x00;								// 设置程序代码等待参数，等待时间为0个时钟，CPU执行程序速度最快

	P0M1 = 0x00;P0M0 = 0x00;		// 设置P0口为准双向口模式 //00：准双向口 01：推挽输出 10：高阻输入 11：开漏输出
	P1M1 = 0x00;P1M0 = 0x00;		// 设置P1口为准双向口模式 //00：准双向口 01：推挽输出 10：高阻输入 11：开漏输出
	P2M1 = 0x00;P2M0 = 0x00;		// 设置P2口为准双向口模式 //00：准双向口 01：推挽输出 10：高阻输入 11：开漏输出
	P3M1 = 0x00;P3M0 = 0x00;		// 设置P3口为准双向口模式 //00：准双向口 01：推挽输出 10：高阻输入 11：开漏输出
	P4M1 = 0x00;P4M0 = 0x00;		// 设置P4口为准双向口模式 //00：准双向口 01：推挽输出 10：高阻输入 11：开漏输出
	P5M1 = 0x00;P5M0 = 0x00;		// 设置P5口为准双向口模式 //00：准双向口 01：推挽输出 10：高阻输入 11：开漏输出
	P6M1 = 0x00;P6M0 = 0x00;		// 设置P6口为准双向口模式 //00：准双向口 01：推挽输出 10：高阻输入 11：开漏输出
	P7M1 = 0x00;P7M0 = 0x00;		// 设置P7口为准双向口模式 //00：准双向口 01：推挽输出 10：高阻输入 11：开漏输出
}
void IOINT_Isr(void) interrupt 13		// 13号中断为保留中断，因为IO口中断号大于31，这里借用13号中断中转
{																		// 关于Keil中断号扩展详细信息，可以参照布丁橘长-STC32G系列视频第36期，或STC32G手册第5.9章节
	u8 intf;
	intf = P3INTF;
	if (intf)
	{
		P3INTF = 0x00;
/*		
		if (intf & 0x01)	//P3.0 口中断
		{
			
		}
		if (intf & 0x02)	//P3.1 口中断
		{
			
		}

		if (intf & 0x04)	//P3.2 口中断
		{
			
		}
*/
		if (intf & 0x08)	//P3.3 口中断
		{
			Blink();				// P2.7口LED闪烁3次
		}
/*
		if (intf & 0x10)	//P3.4 口中断
		{
		
		}
		if (intf & 0x20)	//P3.5 口中断
		{
		
		}
		if (intf & 0x40)	//P3.6 口中断
		{
		
		}
		if (intf & 0x80)	//P3.7 口中断
		{
		
		}
*/
	}
}
void Blink()					// P27闪烁3次
{
	P27 = ~P27;						
	delayms(200);				// 第1次闪烁 亮
	P27 = ~P27;
	delayms(200);				// 第1次闪烁 灭
	
	P27 = ~P27;
	delayms(200);				// 第2次闪烁 亮
	P27 = ~P27;
	delayms(200);				// 第2次闪烁 灭
	
	P27 = ~P27;					
	delayms(200);				// 第3次闪烁 亮	
	P27 = ~P27;						
	delayms(200);				// 第3次闪烁 灭
}