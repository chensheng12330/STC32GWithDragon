//	@布丁橘长 2023/05/08
//  硬件I2C，读写AT24Cxxx系列EEPROM示例，I2C相关函数已在I2C_IO.c/h中定义
//	本例EEPROM型号：AT24C256、AT24C64，4K以及以上容量EEPROM适用
//	1K、2K EEPROM需要将读/写函数，改为1个字节地址函数（AT24Cxx.c/.h中已定义）
//	上电后分别将LED_Buffer1/Buffer2中的流水灯码表写入EEPROM，while循环中分别使用单字节读取和多字节读取方式，读取EEPROM
//  实验效果：LED1-8单个LED流水灯，间隔200ms，完成后，变为2个LED流水灯，间隔200ms
//  I2C使用引脚P3.3(SDA) P3.2(SCL)
//	实验开发板：STC32G12K128屠龙刀三.1 主频@24MHz
//  本程序I2C协议部分、AT24Cxx相关函数，使用了STC32G手册示例程序-I2C主机模式访问AT24C256(中断方式)

#include <STC32G.H>
#include "config.h"
#include "AT24Cxx.h"
#include "delay.h"

bit B_1ms;
u8 m,n;												
u16 count;										// 200毫秒计时

u8 LED_Buffer1[8]= {0xFE,0xFD,0xFB,0xF7,0xEF,0xDF,0xBF,0x7F};	// 流水灯码表1，每次1个LED流水灯
u8 LED_Buffer2[8]= {0xFC,0xF9,0xF3,0xE7,0xCF,0x9F,0x3F,0x7E};	// 流水灯码表2，每次相邻2个LED流水灯
u8 Dat_Buffer[8]={0};

void sysini(void);						// STC32初始化设置
void Timer0_Init(void);				// 定时器0初始化

void main(void)
{
	sysini();										// STC32初始化设置
	Timer0_Init();							// 定时器0初始化
	
//	I2C_S1 = 0;
//	I2C_S0 = 1;								// I2C引脚切换到P2.5(SCL) P2.4(SDA)
	
	I2C_S1 = 1;
	I2C_S0 = 1;									// I2C引脚切换到P3.3(SDA) P3.2(SCL)	
	
	I2CCFG = 0xCD; 							// 使能 I2C，主机模式，总线速度400K
	I2CMSST = 0x00;							// 清零 主机状态标志
	EA = 1;											// 使能EA总中断
		
//==================写字节模式（写入间隔需要大于5毫秒）====================
for(m = 0;m<8;m++)
	{
		EEPROM_WriteAbyte(0x00,m,LED_Buffer1[m]);		// 在地址 0x00 m ，写入1个字节
		delayms(5);								// 延时5毫秒（写字节模式时，STOP信号发出后，EEPROM进入 自写入周期，耗时最多5毫秒）
	}
	
	
//======================写页面模式==========================================
	EEPROM_WriteNbyte(0x00,0x08,LED_Buffer2, 8); 	// 写入多个字节，共8字节（最多不能超过EEPROM的页面大小）

	while (1)
	{
		if(B_1ms == 1)						// 1毫秒到
		{
			B_1ms = 0;							// 清零1毫秒标志
			count++;								// 200毫秒计数+1
		}	

		if(count >= 200)					// 200毫秒到
		{
			count = 0;							// 清零200毫秒计时计数
			
//========================随机地址读取（每次1个字节）========================		
			if(n < 8)	P2 = EEPROM_ReadAbyte(0x00,n);		// 从地址0x00 n 处，读取1个字节
			
			
//======================序列读取(读取多个字节)================================	
			if(n ==8) EEPROM_ReadNbyte(0x00,0x08,Dat_Buffer,8);	// 从地址 0x0008 开始，读取8个字节，存入Dat_Buffer[]中
		
			
			if(n >= 8 && n <=15) P2 = Dat_Buffer[n-8];		// 按照读取的数据，P2口流水灯
			n++;										// n计数范围0-15，完成2次灯
			n &= 0x0F;							// 防溢出，当n=15，即0x0F，当n大于15，与操作清零高4位，限定取值范围0-15
		}	
	}
}
void sysini()
{
	EAXFR = 1; 									// 使能访问 XFR
	CKCON = 0x00; 							// 设置外部数据总线速度为最快
	WTST = 0x00;								// 设置程序代码等待参数，等待时间为0个时钟，CPU执行程序速度最快

	P0M1 = 0x00;P0M0 = 0x00;		// 设置P0口为准双向口模式 //00：准双向口 01：推挽输出 10：高阻输入 11：开漏输出
	P1M1 = 0x00;P1M0 = 0x00;		// 设置P1口为准双向口模式 //00：准双向口 01：推挽输出 10：高阻输入 11：开漏输出
	P2M1 = 0x00;P2M0 = 0x00;		// 设置P2口为准双向口模式 //00：准双向口 01：推挽输出 10：高阻输入 11：开漏输出
	P3M1 = 0x0C;P3M0 = 0x0C;		// P3.2 P3.3口为开漏输出  //00：准双向口 01：推挽输出 10：高阻输入 11：开漏输出
	P4M1 = 0x00;P4M0 = 0x00;		// 设置P4口为准双向口模式 //00：准双向口 01：推挽输出 10：高阻输入 11：开漏输出
	P5M1 = 0x00;P5M0 = 0x00;		// 设置P5口为准双向口模式 //00：准双向口 01：推挽输出 10：高阻输入 11：开漏输出
	P6M1 = 0x00;P6M0 = 0x00;		// 设置P6口为准双向口模式 //00：准双向口 01：推挽输出 10：高阻输入 11：开漏输出
	P7M1 = 0x00;P7M0 = 0x00;		// 设置P7口为准双向口模式 //00：准双向口 01：推挽输出 10：高阻输入 11：开漏输出
}
void Timer0_Isr(void) interrupt 1
{
	B_1ms = 1;									// 1毫秒标志
}
void Timer0_Init(void)				//1毫秒@22.1184MHz
{
	AUXR |= 0x80;								//定时器时钟1T模式
	TMOD &= 0xF0;								//设置定时器模式
	TL0 = 0x9A;									//设置定时初始值
	TH0 = 0xA9;									//设置定时初始值
	TF0 = 0;										//清除TF0标志
	TR0 = 1;										//定时器0开始计时
	ET0 = 1;										//使能定时器0中断
}