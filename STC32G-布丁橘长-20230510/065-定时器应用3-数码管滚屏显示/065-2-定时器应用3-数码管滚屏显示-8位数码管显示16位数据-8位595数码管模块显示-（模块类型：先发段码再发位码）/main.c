//		@布丁橘长 2023/02/16
//		数码管滚屏显示，第一屏：HELLO，第二屏：20230216，第三屏：AbCdEF
//		使用定时器0-模式0-1T模式-预分频，定时200毫秒
//		8位共阳极数码管模块-74HC595级联驱动，数码管模块引脚定义：DS(DIO):P6.6 SH(SCK):P6.5 ST(RCK):P6.4
//		实验开发板：STC32G12K128-LQFP64 屠龙刀三.1 主频12MHz

#include <STC32G.H>
#include "config.h"
#include "seg595.h"

void Timer0_Init(void);		//定时器0初始化函数声明

u8 number;				//数码管显示的数字
//									灭 灭  H  E  L L  0 灭
u8 segstring[24] = {22,22,16,14,17,17,0,22,			//第1屏：HELL0
//								  2  0  2  3  0  2  1  6
										2 ,0 ,2 ,3 ,0 ,2 ,1 ,6,			//第2屏：20230216
//									灭	A	 b C  d  E  F  灭
										22,10,11,12,13,14,15,22};		//第3屏：AbCdEF
u8 segdig;				//数组位
u8 segdelay;			//数码管显示停留时间
void main()
{	
	u8 i;
	EAXFR = 1; 			// 使能访问 XFR
	CKCON = 0x00; 	// 设置外部数据总线速度为最快
	WTST = 0x00;		// 设置程序代码等待参数，等待时间为0个时钟，CPU执行程序速度最快

	P0M1 = 0x00;P0M0 = 0x00;		//设置P0口为准双向口模式 //00：准双向口 01：推挽输出 10：高阻输入 11：开漏输出
	P1M1 = 0x00;P1M0 = 0x00;		//设置P1口为准双向口模式 //00：准双向口 01：推挽输出 10：高阻输入 11：开漏输出
	P2M1 = 0x00;P2M0 = 0x00;		//设置P2口为准双向口模式 //00：准双向口 01：推挽输出 10：高阻输入 11：开漏输出
	P3M1 = 0x00;P3M0 = 0x00;		//设置P3口为准双向口模式 //00：准双向口 01：推挽输出 10：高阻输入 11：开漏输出
	P4M1 = 0x00;P4M0 = 0x00;		//设置P4口为准双向口模式 //00：准双向口 01：推挽输出 10：高阻输入 11：开漏输出
	P5M1 = 0x00;P5M0 = 0x00;		//设置P5口为准双向口模式 //00：准双向口 01：推挽输出 10：高阻输入 11：开漏输出
	P6M1 = 0x00;P6M0 = 0x00;		//设置P6口为准双向口模式 //00：准双向口 01：推挽输出 10：高阻输入 11：开漏输出
	P7M1 = 0x00;P7M0 = 0x00;		//设置P7口为准双向口模式 //00：准双向口 01：推挽输出 10：高阻输入 11：开漏输出
	
	Timer0_Init();		//定时器0初始化
	EA = 1;						//使能总中断	
	segdig = 0;
	while(1)
	{
		for(i = 0;i < 8;i++)														
		{
			if(i+segdig <= 23)
			{
				SEG_Disp(segstring[i+segdig],(u8)(i+1));		//第1-8位分别显示，数组第i+segdig个字符
			}																							//例：segdig=0时，8位分别显示数组0-7个字符 “  HELL0 ”
																										// 		segdig=2时，8位分别显示数组2-10个字符“HELL0 20”
																										//	  segdig=4时，8位分别显示数组4-12个字符“LL0 2023”
			if(i+segdig > 23)									
			{
				SEG_Disp(segstring[i+segdig-23],(u8)(i+1)); //当i+segdig超过数组24位时，超出部分从数组0个元素开始
			}
		}
	}
}
void Timer0_Isr(void) interrupt 1		
{
	if((segdig == 0) || (segdig == 8) || (segdig == 16))//每一屏数据，停留显示
	{
		segdelay++;																				//开始计时
	}
	if(segdelay == 10) segdelay = 0;										//计时200毫秒*10
	if(segdelay == 0) segdig++;													//计时结束后，开始滚屏
	if(segdig > 23) segdig = 0;													//滚屏24位后清零
}

void Timer0_Init(void)		//200毫秒@12.000MHz
{
	TM0PS = 0x24;						//设置定时器时钟预分频 ( 注意:并非所有系列都有此寄存器,详情请查看数据手册 )
	AUXR |= 0x80;						//定时器时钟1T模式
	TMOD &= 0xF0;						//设置定时器模式
	TL0 = 0x9F;							//设置定时初始值
	TH0 = 0x02;							//设置定时初始值
	TF0 = 0;								//清除TF0标志
	TR0 = 1;								//定时器0开始计时
	ET0 = 1;								//使能定时器0中断
}