#include "NTC.h"
#include "config.h"

extern u16 adc_result;					//	ADC转换结果;

u16 temp_table[]={ 	//10KB3950
        3983,			//0：-40℃
				3975,			//1: -39℃
				3967,			//2：-38℃
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				156,			//159: 119℃
				151 			//160：120℃
};

float CalculationTemperature(u16 adc)
{
	float temper,temper_float;
  u16 min,middle,max;
	float temp1,temp2;
  min = 0;        			//-40度
  max = 160;      			//120度
	
   if(adc == temp_table[min])  temper = min - 40;
   else if(adc == temp_table[max])  temper = max - 40;
   while(min <= max)																			// 二分搜索法
   {
			middle = (min + max) / 2;
      if(adc == temp_table[middle]) temper = middle - 40;
      if(adc > temp_table[middle]) max = middle - 1;
			else min = middle + 1;
      if(min >= max)
			{
				temp1 = temp_table[max]-adc;
				temp2 = temp_table[max-1] - temp_table[max];
				temper_float = temp1 / temp2;
				temper = max + temper_float - 40;
      }
    }
   return temper;
}