/*---------------------------------------------------------------------*/
/* --- STC MCU Limited ------------------------------------------------*/
/* --- STC 1T Series MCU Demo Programme -------------------------------*/
/* --- Mobile: (86)13922805190 ----------------------------------------*/
/* --- Fax: 86-0513-55012956,55012947,55012969 ------------------------*/
/* --- Tel: 86-0513-55012928,55012929,55012966 ------------------------*/
/* --- Web: www.STCMCU.com --------------------------------------------*/
/* --- Web: www.STCMCUDATA.com  ---------------------------------------*/
/* --- QQ:  800003751 -------------------------------------------------*/
/* 如果要在程序中使用此代码,请在程序中注明使用了STC的资料及程序            */
/*---------------------------------------------------------------------*/

/*************  功能说明    **************

本例程基于STC32G为主控芯片的实验箱进行编写测试。

热敏电阻采集测温程序, NTC使用1%精度的MF52 10K@25度.

测温度时, 使用12位的ADC值, 使用对分查找表格来计算, 小数点后一位数是用线性插补来计算的.

右边4位数码管显示温度值, 分辨率0.1度.

******************************************/

#include "FreeRTOS.h"
#include "task.h"
#include "STC32G_ADC.h"

#include "ntc.h"
#include "display.h"

static void prvNetEvent( void );
static uint16_t prvGet_Temperature(uint16_t adc);

/* RTC任务函数 */
portTASK_FUNCTION( vNtcTask, pvParameters )
{
    
    UNUSED( pvParameters );
    
//    P1M1 |= 0x08;   P1M0 &= ~0x08;   //设置 P1.3 为 ADC 输入口
    while(1)
    {
        prvNetEvent();

        vTaskDelay(300);
    }
    
    vTaskDelete(NULL);
}   


static void prvNetEvent( void )
{
    uint8_t  i;
    uint16_t j;
    j = Get_ADCResult(3);  //参数0~15,查询方式做一次ADC, 返回值就是结果, == 4096 为错误

    if(j < 4096)
    {
        j = prvGet_Temperature(j); //计算温度值

        if(j >= 400)    F0 = 0, j -= 400;       //温度 >= 0度
        else            F0 = 1, j  = 400 - j;   //温度 <  0度
        pucLEDBuffer[4] = j / 1000;     //显示温度值
        pucLEDBuffer[5] = (j % 1000) / 100;
        pucLEDBuffer[6] = (j % 100) / 10 + DIS_DOT;
        pucLEDBuffer[7] = j % 10;
        if(pucLEDBuffer[4] == 0)    pucLEDBuffer[4] = DIS_BLACK;
        if(F0)  pucLEDBuffer[4] = DIS_;     //显示-
    }
    else    //错误
    {
        for(i=0; i<8; i++)  pucLEDBuffer[i] = DIS_;
    }
}


//  MF52E 10K at 25, B = 3950, ADC = 12 bits
uint16_t code temp_table[]={
        140,    //;-40  0
        149,    //;-39  1
        159,    //;-38  2
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        3938,   //;119  159
        3942    //;120  160
};

/********************  计算温度 ***********************************************/
// 计算结果: 0对应-40.0度, 400对应0度, 625对应25.0度, 最大1600对应120.0度. 
// 为了通用, ADC输入为12bit的ADC值.
// 电路和软件算法设计: Coody
/**********************************************/

#define     D_SCALE     10      //结果放大倍数, 放大10倍就是保留一位小数
static uint16_t prvGet_Temperature(uint16_t adc)
{
    uint16_t code *p;
    uint16_t i;
    uint8_t  j,k,min,max;
    
    adc = 4096 - adc;   //Rt接地
    p = temp_table;
    if(adc < p[0])      return (0xfffe);
    if(adc > p[160])    return (0xffff);
    
    min = 0;        //-40度
    max = 160;      //120度

    for(j=0; j<5; j++)  //对分查表
    {
        k = min / 2 + max / 2;
        if(adc <= p[k]) max = k;
        else            min = k;
    }
         if(adc == p[min])  i = min * D_SCALE;
    else if(adc == p[max])  i = max * D_SCALE;
    else    // min < temp < max
    {
        while(min <= max)
        {
            min++;
            if(adc == p[min])   {i = min * D_SCALE; break;}
            else if(adc < p[min])
            {
                min--;
                i = p[min]; //min
                j = (adc - i) * D_SCALE / (p[min+1] - i);
                i = min;
                i *= D_SCALE;
                i += j;
                break;
            }
        }
    }
    return i;
}
