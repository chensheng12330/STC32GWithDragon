P0          DATA    080H
SP          DATA    081H
DPL         DATA    082H
DPH         DATA    083H
DPXL        DATA    084H
SPH         DATA    085H
PCON        DATA    087H
TCON        DATA    088H
TMOD        DATA    089H
TL0         DATA    08AH
TL1         DATA    08BH
TH0         DATA    08CH
TH1         DATA    08DH
AUXR        DATA    08EH
INTCLKO     DATA    08FH
P1          DATA    090H
P1M1        DATA    091H
P1M0        DATA    092H
P0M1        DATA    093H
P0M0        DATA    094H
P2M1        DATA    095H
P2M0        DATA    096H
AUXR2       DATA    097H
SCON        DATA    098H
SBUF        DATA    099H
S2CON       DATA    09AH
S2BUF       DATA    09BH
ICECR       DATA    09CH
IRCBAND     DATA    09DH
LIRTRIM     DATA    09EH
IRTRIM      DATA    09FH
P2          DATA    0A0H
BUSSPEED    DATA    0A1H
P_SW1       DATA    0A2H
V33TRIM     DATA    0A3H
BGTRIM      DATA    0A5H
VRTRIM      DATA    0A6H
IE          DATA    0A8H
SADDR       DATA    0A9H
WKTCL       DATA    0AAH
WKTCH       DATA    0ABH
S3CON       DATA    0ACH
S3BUF       DATA    0ADH
TA          DATA    0AEH
IE2         DATA    0AFH
P3          DATA    0B0H
P3M1        DATA    0B1H
P3M0        DATA    0B2H
P4M1        DATA    0B3H
P4M0        DATA    0B4H
IP2         DATA    0B5H
IP2H        DATA    0B6H
IPH         DATA    0B7H
IP          DATA    0B8H
SADEN       DATA    0B9H
P_SW2       DATA    0BAH
P_SW3       DATA    0BBH
ADC_CONTR   DATA    0BCH
ADC_RES     DATA    0BDH
ADC_RESL    DATA    0BEH
P4          DATA    0C0H 
WDT_CONTR   DATA    0C1H
IAP_DATA    DATA    0C2H 
IAP_ADDRH   DATA    0C3H 
IAP_ADDRL   DATA    0C4H 
IAP_CMD     DATA    0C5H 
IAP_TRIG    DATA    0C6H 
IAP_CONTR   DATA    0C7H 
P5          DATA    0C8H 
P5M1        DATA    0C9H 
P5M0        DATA    0CAH 
P6M1        DATA    0CBH 
P6M0        DATA    0CCH 
SPSTAT      DATA    0CDH 
SPCTL       DATA    0CEH 
SPDAT       DATA    0CFH 
PSW         DATA    0D0H 
PSW1        DATA    0D1H 
T4H         DATA    0D2H
T4L         DATA    0D3H
T3H         DATA    0D4H
T3L         DATA    0D5H
T2H         DATA    0D6H
T2L         DATA    0D7H
USBCLK      DATA    0DCH
T4T3M       DATA    0DDH
ADCCFG      DATA    0DEH
IP3         DATA    0DFH
ACC         DATA    0E0H 
P7M1        DATA    0E1H
P7M0        DATA    0E2H
DPS         DATA    0E3H 
DPL1        DATA    0E4H 
DPH1        DATA    0E5H 
CMPCR1      DATA    0E6H 
CMPCR2      DATA    0E7H 
P6          DATA    0E8H 
WTST        DATA    0E9H 
CKCON       DATA    0EAH 
MXAX        DATA    0EBH 
USBDAT      DATA    0ECH
DMAIR       DATA    0EDH
IP3H        DATA    0EEH
AUXINTIF    DATA    0EFH
B           DATA    0F0H 
CANICR      DATA    0F1H
USBCON      DATA    0F4H
IAP_TPS     DATA    0F5H
IAP_ADDRE   DATA    0F6H
ICHECR      DATA    0F7H 
P7          DATA    0F8H 
LINICR      DATA    0F9H
LINAR       DATA    0FAH
LINDR       DATA    0FBH
USBADR      DATA    0FCH
S4CON       DATA    0FDH
S4BUF       DATA    0FEH 
RSTCFG      DATA    0FFH

P07        BIT     P0.7
P06        BIT     P0.6
P05        BIT     P0.5
P04        BIT     P0.4
P03        BIT     P0.3
P02        BIT     P0.2
P01        BIT     P0.1
P00        BIT     P0.0
P17        BIT     P1.7
P16        BIT     P1.6
P15        BIT     P1.5
P14        BIT     P1.4
P13        BIT     P1.3
P12        BIT     P1.2
P11        BIT     P1.1
P10        BIT     P1.0
P27        BIT     P2.7
P26        BIT     P2.6
P25        BIT     P2.5
P24        BIT     P2.4
P23        BIT     P2.3
P22        BIT     P2.2
P21        BIT     P2.1
P20        BIT     P2.0
P37        BIT     P3.7
P36        BIT     P3.6
P35        BIT     P3.5
P34        BIT     P3.4
P33        BIT     P3.3
P32        BIT     P3.2
P31        BIT     P3.1
P30        BIT     P3.0
P47        BIT     P4.7
P46        BIT     P4.6
P45        BIT     P4.5
P44        BIT     P4.4
P43        BIT     P4.3
P42        BIT     P4.2
P41        BIT     P4.1
P40        BIT     P4.0
P57        BIT     P5.7
P56        BIT     P5.6
P55        BIT     P5.5
P54        BIT     P5.4
P53        BIT     P5.3
P52        BIT     P5.2
P51        BIT     P5.1
P50        BIT     P5.0
P67        BIT     P6.7
P66        BIT     P6.6
P65        BIT     P6.5
P64        BIT     P6.4
P63        BIT     P6.3
P62        BIT     P6.2
P61        BIT     P6.1
P60        BIT     P6.0
P77        BIT     P7.7
P76        BIT     P7.6
P75        BIT     P7.5
P74        BIT     P7.4
P73        BIT     P7.3
P72        BIT     P7.2
P71        BIT     P7.1
P70        BIT     P7.0

IT0        BIT     TCON.0
IE0        BIT     TCON.1
IT1        BIT     TCON.2
IE1        BIT     TCON.3
TR0        BIT     TCON.4
TF0        BIT     TCON.5
TR1        BIT     TCON.6
TF1        BIT     TCON.7

RI         BIT     SCON.0
TI         BIT     SCON.1
RB8        BIT     SCON.2
TB8        BIT     SCON.3
REN        BIT     SCON.4
SM2        BIT     SCON.5
SM1        BIT     SCON.6
SM0        BIT     SCON.7

EX0        BIT     IE.0
ET0        BIT     IE.1
EX1        BIT     IE.2
ET1        BIT     IE.3
ES         BIT     IE.4
EADC       BIT     IE.5
ELVD       BIT     IE.6
EA         BIT     IE.7

PX0        BIT     IP.0
PT0        BIT     IP.1
PX1        BIT     IP.2
PT1        BIT     IP.3
PS         BIT     IP.4
PADC       BIT     IP.5
PLVD       BIT     IP.6

P          BIT     PSW.0
OV         BIT     PSW.2
RS0        BIT     PSW.3
RS1        BIT     PSW.4
F0         BIT     PSW.5
AC         BIT     PSW.6
CY         BIT     PSW.7

INT4       BIT     P3.0
INT0       BIT     P3.2
INT1       BIT     P3.3
T0         BIT     P3.4
T1         BIT     P3.5
INT2       BIT     P3.6
INT3       BIT     P3.7


CKSEL       EQU     007EFE00H
CLKDIV      EQU     007EFE01H
IRC24MCR    EQU     007EFE02H
XOSCCR      EQU     007EFE03H
IRC32KCR    EQU     007EFE04H
MCLKOCR     EQU     007EFE05H
IRCDB       EQU     007EFE06H
IRC48MCR    EQU     007EFE07H
X32KCR      EQU     007EFE08H
IRC48ATRIM  EQU     007EFE09H
IRC48BTRIM  EQU     007EFE0AH
HSCKDIV     EQU     007EFE0BH

P0PU        EQU     007EFE10H
P1PU        EQU     007EFE11H
P2PU        EQU     007EFE12H
P3PU        EQU     007EFE13H
P4PU        EQU     007EFE14H
P5PU        EQU     007EFE15H
P6PU        EQU     007EFE16H
P7PU        EQU     007EFE17H
P0NCS       EQU     007EFE18H
P1NCS       EQU     007EFE19H
P2NCS       EQU     007EFE1AH
P3NCS       EQU     007EFE1BH
P4NCS       EQU     007EFE1CH
P5NCS       EQU     007EFE1DH
P6NCS       EQU     007EFE1EH
P7NCS       EQU     007EFE1FH
P0SR        EQU     007EFE20H
P1SR        EQU     007EFE21H
P2SR        EQU     007EFE22H
P3SR        EQU     007EFE23H
P4SR        EQU     007EFE24H
P5SR        EQU     007EFE25H
P6SR        EQU     007EFE26H
P7SR        EQU     007EFE27H
P0DR        EQU     007EFE28H
P1DR        EQU     007EFE29H
P2DR        EQU     007EFE2AH
P3DR        EQU     007EFE2BH
P4DR        EQU     007EFE2CH
P5DR        EQU     007EFE2DH
P6DR        EQU     007EFE2EH
P7DR        EQU     007EFE2FH
P0IE        EQU     007EFE30H
P1IE        EQU     007EFE31H
P2IE        EQU     007EFE32H
P3IE        EQU     007EFE33H
P4IE        EQU     007EFE34H
P5IE        EQU     007EFE35H
P6IE        EQU     007EFE36H
P7IE        EQU     007EFE37H

LCMIFCFG    EQU     007EFE50H
LCMIFCFG2   EQU     007EFE51H
LCMIFCR     EQU     007EFE52H
LCMIFSTA    EQU     007EFE53H
LCMIFDATL   EQU     007EFE54H
LCMIFDATH   EQU     007EFE55H

RTCCR       EQU     007EFE60H
RTCCFG      EQU     007EFE61H
RTCIEN      EQU     007EFE62H
RTCIF       EQU     007EFE63H
ALAHOUR     EQU     007EFE64H
ALAMIN      EQU     007EFE65H
ALASEC      EQU     007EFE66H
ALASSEC     EQU     007EFE67H
INIYEAR     EQU     007EFE68H
INIMONTH    EQU     007EFE69H
INIDAY      EQU     007EFE6AH
INIHOUR     EQU     007EFE6BH
INIMIN      EQU     007EFE6CH
INISEC      EQU     007EFE6DH
INISSEC     EQU     007EFE6EH
YEAR        EQU     007EFE70H
MONTH       EQU     007EFE71H
DAY         EQU     007EFE72H
HOUR        EQU     007EFE73H
MIN         EQU     007EFE74H
SEC         EQU     007EFE75H
SSEC        EQU     007EFE76H

I2CCFG      EQU     007EFE80H
I2CMSCR     EQU     007EFE81H
I2CMSST     EQU     007EFE82H
I2CSLCR     EQU     007EFE83H
I2CSLST     EQU     007EFE84H
I2CSLADR    EQU     007EFE85H
I2CTXD      EQU     007EFE86H
I2CRXD      EQU     007EFE87H
I2CMSAUX    EQU     007EFE88H

SPFUNC      EQU     007EFE98H
RSTFLAG     EQU     007EFE99H
RSTCR0      EQU     007EFE9AH
RSTCR1      EQU     007EFE9BH
RSTCR2      EQU     007EFE9CH
RSTCR3      EQU     007EFE9DH
RSTCR4      EQU     007EFE9EH
RSTCR5      EQU     007EFE9FH

TM0PS       EQU     007EFEA0H
TM1PS       EQU     007EFEA1H
TM2PS       EQU     007EFEA2H
TM3PS       EQU     007EFEA3H
TM4PS       EQU     007EFEA4H
ADCTIM      EQU     007EFEA8H
T3T4PS      EQU     007EFEACH
ADCEXCFG    EQU     007EFEADH
CMPEXCFG    EQU     007EFEAEH


PWMA_ETRPS  EQU     007EFEB0H
PWMA_ENO    EQU     007EFEB1H
PWMA_PS     EQU     007EFEB2H
PWMA_IOAUX  EQU     007EFEB3H
PWMB_ETRPS  EQU     007EFEB4H
PWMB_ENO    EQU     007EFEB5H
PWMB_PS     EQU     007EFEB6H
PWMB_IOAUX  EQU     007EFEB7H
PWMA_CR1    EQU     007EFEC0H
PWMA_CR2    EQU     007EFEC1H
PWMA_SMCR   EQU     007EFEC2H
PWMA_ETR    EQU     007EFEC3H
PWMA_IER    EQU     007EFEC4H
PWMA_SR1    EQU     007EFEC5H
PWMA_SR2    EQU     007EFEC6H
PWMA_EGR    EQU     007EFEC7H
PWMA_CCMR1  EQU     007EFEC8H
PWMA_CCMR2  EQU     007EFEC9H
PWMA_CCMR3  EQU     007EFECAH
PWMA_CCMR4  EQU     007EFECBH
PWMA_CCER1  EQU     007EFECCH
PWMA_CCER2  EQU     007EFECDH
PWMA_CNTRH  EQU     007EFECEH
PWMA_CNTRL  EQU     007EFECFH
PWMA_PSCRH  EQU     007EFED0H
PWMA_PSCRL  EQU     007EFED1H
PWMA_ARRH   EQU     007EFED2H
PWMA_ARRL   EQU     007EFED3H
PWMA_RCR    EQU     007EFED4H
PWMA_CCR1H  EQU     007EFED5H
PWMA_CCR1L  EQU     007EFED6H
PWMA_CCR2H  EQU     007EFED7H
PWMA_CCR2L  EQU     007EFED8H
PWMA_CCR3H  EQU     007EFED9H
PWMA_CCR3L  EQU     007EFEDAH
PWMA_CCR4H  EQU     007EFEDBH
PWMA_CCR4L  EQU     007EFEDCH
PWMA_BKR    EQU     007EFEDDH
PWMA_DTR    EQU     007EFEDEH
PWMA_OISR   EQU     007EFEDFH
PWMB_CR1    EQU     007EFEE0H
PWMB_CR2    EQU     007EFEE1H
PWMB_SMCR   EQU     007EFEE2H
PWMB_ETR    EQU     007EFEE3H
PWMB_IER    EQU     007EFEE4H
PWMB_SR1    EQU     007EFEE5H
PWMB_SR2    EQU     007EFEE6H
PWMB_EGR    EQU     007EFEE7H
PWMB_CCMR1  EQU     007EFEE8H
PWMB_CCMR2  EQU     007EFEE9H
PWMB_CCMR3  EQU     007EFEEAH
PWMB_CCMR4  EQU     007EFEEBH
PWMB_CCER1  EQU     007EFEECH
PWMB_CCER2  EQU     007EFEEDH
PWMB_CNTRH  EQU     007EFEEEH
PWMB_CNTRL  EQU     007EFEEFH
PWMB_PSCRH  EQU     007EFEF0H
PWMB_PSCRL  EQU     007EFEF1H
PWMB_ARRH   EQU     007EFEF2H
PWMB_ARRL   EQU     007EFEF3H
PWMB_RCR    EQU     007EFEF4H
PWMB_CCR1H  EQU     007EFEF5H
PWMB_CCR1L  EQU     007EFEF6H
PWMB_CCR2H  EQU     007EFEF7H
PWMB_CCR2L  EQU     007EFEF8H
PWMB_CCR3H  EQU     007EFEF9H
PWMB_CCR3L  EQU     007EFEFAH
PWMB_CCR4H  EQU     007EFEFBH
PWMB_CCR4L  EQU     007EFEFCH
PWMB_CCR5H  EQU     007EFEF5H
PWMB_CCR5L  EQU     007EFEF6H
PWMB_CCR6H  EQU     007EFEF7H
PWMB_CCR6L  EQU     007EFEF8H
PWMB_CCR7H  EQU     007EFEF9H
PWMB_CCR7L  EQU     007EFEFAH
PWMB_CCR8H  EQU     007EFEFBH
PWMB_CCR8L  EQU     007EFEFCH
PWMB_BKR    EQU     007EFEFDH
PWMB_DTR    EQU     007EFEFEH
PWMB_OISR   EQU     007EFEFFH

P0INTE      EQU     007EFD00H
P1INTE      EQU     007EFD01H
P2INTE      EQU     007EFD02H
P3INTE      EQU     007EFD03H
P4INTE      EQU     007EFD04H
P5INTE      EQU     007EFD05H
P6INTE      EQU     007EFD06H
P7INTE      EQU     007EFD07H
P0INTF      EQU     007EFD10H
P1INTF      EQU     007EFD11H
P2INTF      EQU     007EFD12H
P3INTF      EQU     007EFD13H
P4INTF      EQU     007EFD14H
P5INTF      EQU     007EFD15H
P6INTF      EQU     007EFD16H
P7INTF      EQU     007EFD17H
P0IM0       EQU     007EFD20H
P1IM0       EQU     007EFD21H
P2IM0       EQU     007EFD22H
P3IM0       EQU     007EFD23H
P4IM0       EQU     007EFD24H
P5IM0       EQU     007EFD25H
P6IM0       EQU     007EFD26H
P7IM0       EQU     007EFD27H
P0IM1       EQU     007EFD30H
P1IM1       EQU     007EFD31H
P2IM1       EQU     007EFD32H
P3IM1       EQU     007EFD33H
P4IM1       EQU     007EFD34H
P5IM1       EQU     007EFD35H
P6IM1       EQU     007EFD36H
P7IM1       EQU     007EFD37H
P0WKUE      EQU     007EFD40H
P1WKUE      EQU     007EFD41H
P2WKUE      EQU     007EFD42H
P3WKUE      EQU     007EFD43H
P4WKUE      EQU     007EFD44H
P5WKUE      EQU     007EFD45H
P6WKUE      EQU     007EFD46H
P7WKUE      EQU     007EFD47H
                    
PIN_IP      EQU     007EFD60H
PIN_IPH     EQU     007EFD61H

S2CFG       EQU     007EFDB4H
S2ADDR      EQU     007EFDB5H
S2ADEN      EQU     007EFDB6H
USARTCR1    EQU     007EFDC0H
USARTCR2    EQU     007EFDC1H
USARTCR3    EQU     007EFDC2H
USARTCR4    EQU     007EFDC3H
USARTCR5    EQU     007EFDC4H
USARTGTR    EQU     007EFDC5H
USARTBR1    EQU     007EFDC6H
USARTBR2    EQU     007EFDC7H
USART2CR1   EQU     007EFDC8H
USART2CR2   EQU     007EFDC9H
USART2CR3   EQU     007EFDCAH
USART2CR4   EQU     007EFDCBH
USART2CR5   EQU     007EFDCCH
USART2GTR   EQU     007EFDCDH
USART2BR1   EQU     007EFDCEH
USART2BR2   EQU     007EFDCFH

CHIPID      EQU     007EFDE0H

CHIPID0     EQU     007EFDE0H
CHIPID1     EQU     007EFDE1H
CHIPID2     EQU     007EFDE2H
CHIPID3     EQU     007EFDE3H
CHIPID4     EQU     007EFDE4H
CHIPID5     EQU     007EFDE5H
CHIPID6     EQU     007EFDE6H
CHIPID7     EQU     007EFDE7H
CHIPID8     EQU     007EFDE8H
CHIPID9     EQU     007EFDE9H
CHIPID10    EQU     007EFDEAH
CHIPID11    EQU     007EFDEBH
CHIPID12    EQU     007EFDECH
CHIPID13    EQU     007EFDEDH
CHIPID14    EQU     007EFDEEH
CHIPID15    EQU     007EFDEFH
CHIPID16    EQU     007EFDF0H
CHIPID17    EQU     007EFDF1H
CHIPID18    EQU     007EFDF2H
CHIPID19    EQU     007EFDF3H
CHIPID20    EQU     007EFDF4H
CHIPID21    EQU     007EFDF5H
CHIPID22    EQU     007EFDF6H
CHIPID23    EQU     007EFDF7H
CHIPID24    EQU     007EFDF8H
CHIPID25    EQU     007EFDF9H
CHIPID26    EQU     007EFDFAH
CHIPID27    EQU     007EFDFBH
CHIPID28    EQU     007EFDFCH
CHIPID29    EQU     007EFDFDH
CHIPID30    EQU     007EFDFEH
CHIPID31    EQU     007EFDFFH

HSPWMA_CFG      EQU     007EFBF0H
HSPWMA_ADR      EQU     007EFBF1H
HSPWMA_DAT      EQU     007EFBF2H

HSPWMB_CFG      EQU     007EFBF4H
HSPWMB_ADR      EQU     007EFBF5H
HSPWMB_DAT      EQU     007EFBF6H

HSSPI_CFG       EQU     007EFBF8H
HSSPI_CFG2      EQU     007EFBF9H
HSSPI_STA       EQU     007EFBFAH


DMA_M2M_CFG     EQU     007EFA00H
DMA_M2M_CR      EQU     007EFA01H
DMA_M2M_STA     EQU     007EFA02H
DMA_M2M_AMT     EQU     007EFA03H
DMA_M2M_DONE    EQU     007EFA04H
DMA_M2M_TXAH    EQU     007EFA05H
DMA_M2M_TXAL    EQU     007EFA06H
DMA_M2M_RXAH    EQU     007EFA07H
DMA_M2M_RXAL    EQU     007EFA08H
                      
DMA_ADC_CFG     EQU     007EFA10H
DMA_ADC_CR      EQU     007EFA11H
DMA_ADC_STA     EQU     007EFA12H
DMA_ADC_RXAH    EQU     007EFA17H
DMA_ADC_RXAL    EQU     007EFA18H
DMA_ADC_CFG2    EQU     007EFA19H
DMA_ADC_CHSW0   EQU     007EFA1AH
DMA_ADC_CHSW1   EQU     007EFA1BH
                      
DMA_SPI_CFG     EQU     007EFA20H
DMA_SPI_CR      EQU     007EFA21H
DMA_SPI_STA     EQU     007EFA22H
DMA_SPI_AMT     EQU     007EFA23H
DMA_SPI_DONE    EQU     007EFA24H
DMA_SPI_TXAH    EQU     007EFA25H
DMA_SPI_TXAL    EQU     007EFA26H
DMA_SPI_RXAH    EQU     007EFA27H
DMA_SPI_RXAL    EQU     007EFA28H
DMA_SPI_CFG2    EQU     007EFA29H
                      
DMA_UR1T_CFG    EQU     007EFA30H
DMA_UR1T_CR     EQU     007EFA31H
DMA_UR1T_STA    EQU     007EFA32H
DMA_UR1T_AMT    EQU     007EFA33H
DMA_UR1T_DONE   EQU     007EFA34H
DMA_UR1T_TXAH   EQU     007EFA35H
DMA_UR1T_TXAL   EQU     007EFA36H
DMA_UR1R_CFG    EQU     007EFA38H
DMA_UR1R_CR     EQU     007EFA39H
DMA_UR1R_STA    EQU     007EFA3AH
DMA_UR1R_AMT    EQU     007EFA3BH
DMA_UR1R_DONE   EQU     007EFA3CH
DMA_UR1R_RXAH   EQU     007EFA3DH
DMA_UR1R_RXAL   EQU     007EFA3EH
                      
DMA_UR2T_CFG    EQU     007EFA40H
DMA_UR2T_CR     EQU     007EFA41H
DMA_UR2T_STA    EQU     007EFA42H
DMA_UR2T_AMT    EQU     007EFA43H
DMA_UR2T_DONE   EQU     007EFA44H
DMA_UR2T_TXAH   EQU     007EFA45H
DMA_UR2T_TXAL   EQU     007EFA46H
DMA_UR2R_CFG    EQU     007EFA48H
DMA_UR2R_CR     EQU     007EFA49H
DMA_UR2R_STA    EQU     007EFA4AH
DMA_UR2R_AMT    EQU     007EFA4BH
DMA_UR2R_DONE   EQU     007EFA4CH
DMA_UR2R_RXAH   EQU     007EFA4DH
DMA_UR2R_RXAL   EQU     007EFA4EH
                      
DMA_UR3T_CFG    EQU     007EFA50H
DMA_UR3T_CR     EQU     007EFA51H
DMA_UR3T_STA    EQU     007EFA52H
DMA_UR3T_AMT    EQU     007EFA53H
DMA_UR3T_DONE   EQU     007EFA54H
DMA_UR3T_TXAH   EQU     007EFA55H
DMA_UR3T_TXAL   EQU     007EFA56H
DMA_UR3R_CFG    EQU     007EFA58H
DMA_UR3R_CR     EQU     007EFA59H
DMA_UR3R_STA    EQU     007EFA5AH
DMA_UR3R_AMT    EQU     007EFA5BH
DMA_UR3R_DONE   EQU     007EFA5CH
DMA_UR3R_RXAH   EQU     007EFA5DH
DMA_UR3R_RXAL   EQU     007EFA5EH
                      
DMA_UR4T_CFG    EQU     007EFA60H
DMA_UR4T_CR     EQU     007EFA61H
DMA_UR4T_STA    EQU     007EFA62H
DMA_UR4T_AMT    EQU     007EFA63H
DMA_UR4T_DONE   EQU     007EFA64H
DMA_UR4T_TXAH   EQU     007EFA65H
DMA_UR4T_TXAL   EQU     007EFA66H
DMA_UR4R_CFG    EQU     007EFA68H
DMA_UR4R_CR     EQU     007EFA69H
DMA_UR4R_STA    EQU     007EFA6AH
DMA_UR4R_AMT    EQU     007EFA6BH
DMA_UR4R_DONE   EQU     007EFA6CH
DMA_UR4R_RXAH   EQU     007EFA6DH
DMA_UR4R_RXAL   EQU     007EFA6EH
                      
DMA_LCM_CFG     EQU     007EFA70H
DMA_LCM_CR      EQU     007EFA71H
DMA_LCM_STA     EQU     007EFA72H
DMA_LCM_AMT     EQU     007EFA73H
DMA_LCM_DONE    EQU     007EFA74H
DMA_LCM_TXAH    EQU     007EFA75H
DMA_LCM_TXAL    EQU     007EFA76H
DMA_LCM_RXAH    EQU     007EFA77H
DMA_LCM_RXAL    EQU     007EFA78H

DMA_M2M_AMTH    EQU     007EFA80H
DMA_M2M_DONEH   EQU     007EFA81H
DMA_SPI_AMTH    EQU     007EFA84H
DMA_SPI_DONEH   EQU     007EFA85H
DMA_LCM_AMTH    EQU     007EFA86H
DMA_LCM_DONEH   EQU     007EFA87H
DMA_UR1T_AMTH   EQU     007EFA88H
DMA_UR1T_DONEH  EQU     007EFA89H
DMA_UR1R_AMTH   EQU     007EFA8AH
DMA_UR1R_DONEH  EQU     007EFA8BH
DMA_UR2T_AMTH   EQU     007EFA8CH
DMA_UR2T_DONEH  EQU     007EFA8DH
DMA_UR2R_AMTH   EQU     007EFA8EH
DMA_UR2R_DONEH  EQU     007EFA8FH
DMA_UR3T_AMTH   EQU     007EFA90H
DMA_UR3T_DONEH  EQU     007EFA91H
DMA_UR3R_AMTH   EQU     007EFA92H
DMA_UR3R_DONEH  EQU     007EFA93H
DMA_UR4T_AMTH   EQU     007EFA94H
DMA_UR4T_DONEH  EQU     007EFA95H
DMA_UR4R_AMTH   EQU     007EFA96H
DMA_UR4R_DONEH  EQU     007EFA97H

DMA_SSBT_CFG    EQU     007EFA98H
DMA_SSBT_CR     EQU     007EFA99H
DMA_SSBT_STA    EQU     007EFA9AH
DMA_SSBT_AMT    EQU     007EFA9BH
DMA_SSBT_DONE   EQU     007EFA9CH
DMA_SSBT_TXAH   EQU     007EFA9DH
DMA_SSBT_TXAL   EQU     007EFA9EH
DMA_SSBR_CFG    EQU     007EFAA0H
DMA_SSBR_CR     EQU     007EFAA1H
DMA_SSBR_STA    EQU     007EFAA2H
DMA_SSBR_AMT    EQU     007EFAA3H
DMA_SSBR_DONE   EQU     007EFAA4H
DMA_SSBR_RXAH   EQU     007EFAA5H
DMA_SSBR_RXAL   EQU     007EFAA6H

DMA_SSBT_AMTH   EQU     007EFAA8H
DMA_SSBT_DONEH  EQU     007EFAA9H
DMA_SSBR_AMTH   EQU     007EFAAAH
DMA_SSBR_DONEH  EQU     007EFAABH

DMA_SSB_CR1     EQU     007EFAADH
DMA_SSB_CR2     EQU     007EFAAEH
DMA_SSB_ST      EQU     007EFAAFH

;/////////////////////////////////////////////////
;//DCAN Control Regiter
;/////////////////////////////////////////////////

CANAR           EQU     007EFEBBH
CANDR           EQU     007EFEBCH

CANFDDAR        EQU     007EFEBBH
CANFDDR0        EQU     007EFEBCH
CANFDDR1        EQU     007EFEBDH
CANFDDR2        EQU     007EFEBEH
CANFDDR3        EQU     007EFEBFH

MR              EQU     00H
CMR             EQU     01H
SR              EQU     02H
ISR             EQU     03H
IMR             EQU     04H
RMC             EQU     05H
BTR0            EQU     06H
BTR1            EQU     07H
TM0             EQU     06H
TM1             EQU     07H
TX_BUF0         EQU     08H
TX_BUF1         EQU     09H
TX_BUF2         EQU     0AH
TX_BUF3         EQU     0BH
RX_BUF0         EQU     0CH
RX_BUF1         EQU     0DH
RX_BUF2         EQU     0EH
RX_BUF3         EQU     0FH
ACR0            EQU     10H
ACR1            EQU     11H
ACR2            EQU     12H
ACR3            EQU     13H
AMR0            EQU     14H
AMR1            EQU     15H
AMR2            EQU     16H
AMR3            EQU     17H
ECC             EQU     18H
RXERR           EQU     19H
TXERR           EQU     1AH
ALC             EQU     1BH

;/////////////////////////////////////////////////
;//LIN Control Regiter
;/////////////////////////////////////////////////

LBUF            EQU     00H
LSEL            EQU     01H
LID             EQU     02H
LER             EQU     03H
LIE             EQU     04H
LSR             EQU     05H
LCR             EQU     05H
DLL             EQU     06H
DLH             EQU     07H
HDRL            EQU     08H
HDRH            EQU     09H
HDP             EQU     0AH

